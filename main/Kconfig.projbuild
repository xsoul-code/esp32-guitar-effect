## main/Kconfig.projbuild
```kconfig
menu "WiFi Configuration"

    config ESP_WIFI_SSID
        string "WiFi SSID"
        default "myssid"
        help
            SSID (network name) to connect to.

    config ESP_WIFI_PASSWORD
        string "WiFi Password"
        default "mypassword"
        help
            WiFi password (WPA/WPA2) to use.

    config ESP_MAXIMUM_RETRY
        int "Maximum retry"
        default 5
        help
            Maximum number of retries to connect to the AP.

    config ESP_WIFI_AP_SSID
        string "Pedal WiFi name (SoftAP)"
        default "GuitarFX"
        help
            WiFi network created by the pedal, panel at http://192.168.4.1

    config ESP_WIFI_AP_PASSWORD
        string "Pedal WiFi password (SoftAP)"
        default "guitarfx"
        help
            WPA2 password, at least 8 characters. Empty = open network.

endmenu
```

## sdkconfig.defaults
```kconfig
CONFIG_ESPTOOLPY_FLASHSIZE_4MB=y
CONFIG_PARTITION_TABLE_SINGLE_APP_LARGE=y
CONFIG_HTTPD_WS_SUPPORT=y
CONFIG_SSD1306_128x64=y
CONFIG_OFFSETX=2
CONFIG_SDA_GPIO=21
CONFIG_SCL_GPIO=22
CONFIG_RESET_GPIO=-1
```
